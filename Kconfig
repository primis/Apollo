## Kconfig
```kconfig
mainmenu "Apollo Kernel Configuration"


source "src/arch/Kconfig"

source "src/subsys/Kconfig"

source "src/drivers/Kconfig"

source "src/libc/Kconfig"

source "src/test/Kconfig"
```

## src/arch/Kconfig
```kconfig
menu "Architecture"

config TARGET
    string "Target Definition"
    default x86
    help
        This selects what build type will be used to compile the kernel
        Available platforms are:
         - hosted
         - x86
         - rpi4

if TARGET=hosted
config HOSTED_BASE
    bool "Hosted Base Functionality"
    default y
    select LIBC
    help 
        This package should always be selected when building for hosted
        enviorments. Without it dependencies will not be met.
endif

if TARGET=x86
source "src/arch/x86/Kconfig"
endif

if TARGET=rpi4
source "src/arch/rpi4/Kconfig"
endif

endmenu
```

## src/arch/rpi4/Kconfig
```kconfig
config RPI4_BASE
    bool "Raspberry Pi Model 4B Base Functionality"
    default y
    help
        This package should always be selected when building for the Raspberry
        Pi Model 4B. It contains the bootup code as well as functional drivers.
```

## src/arch/x86/Kconfig
```kconfig
config X86_BASE
    bool "x86 Base Functionality"
    default y
    select LIBC
    select IRQCHIP_8259
    help
        This package should always be selected when building for 32 bit
        Intel machines that are IBM PC compatible. Unless you really
        know what you are doing do not turn this off.
```

## src/arch/x86/hal/Kconfig
```kconfig
config X86_TIMEKEEPING
    bool "x86 Timekeeping"
    default y
    help
        This package allows for IBM PC compatible timekeeping functionality to
        work properly.
```

## src/drivers/Kconfig
```kconfig
menu "Drivers"
source "src/drivers/clock/Kconfig"

source "src/drivers/base/Kconfig"

source "src/drivers/console/Kconfig"

source "src/drivers/irqchip/Kconfig"

source "src/drivers/framebuffer/Kconfig"

endmenu
```

## src/drivers/base/Kconfig
```kconfig
if BASE_SYSTEM

menu "Base System Drivers"

config QEMU_SHUTDOWN
    bool "QEMU Shutdown Hack"
    depends on X86_BASE
    help
        Allow QEMU to be shut down and exit without using ACPI Calls.

config BCM2711_GPIO
    bool "BCM2711 GPIO Driver"
    depends on RPI4_BASE
    help
        Allow configuration of the BCM2711's GPIO pins.
endmenu

endif
```

## src/drivers/clock/Kconfig
```kconfig
menu "Timekeeping"

config CLOCK_RTC_CMOS
    bool "RTC Driver"
    depends on X86_BASE
    help
        The Real Time Clock driver pulls the system time from the CMOS
        chip built into many systems. This enables wall time be read by
        the kernel.

config CLOCK_8254
    bool "Intel 8254"
    depends on X86_BASE
    help
        The Intel 8254 also known as the Programmable Interval Timer
        is standard in all IBM-PC systems. It should be enabled to allow
        Timekeeping functionality unless another method is being used.

endmenu
```

## src/drivers/console/Kconfig
```kconfig
if CONSOLE
menu "Console Drivers"

config CONSOLE_HOSTED
    bool "Hosted Console Support"
    depends on HOSTED_BASE
    help
        Driver that utilizes stdio when on a hosted system

config CONSOLE_VGA
    bool "VGA Text Console"
    select FRAMEBUFFER
    select FRAMEBUFFER_VGA
    help
        Driver that utilizes the VGA Framebuffer for kernel console

source "src/drivers/console/serial/Kconfig"

endmenu

endif # if CONSOLE
```

## src/drivers/console/serial/Kconfig
```kconfig
config CONSOLE_SERIAL_16550_UART
    bool "16550 UART Console"
    help
        Enables the 16550 driver, and enables kernel console output
        on the primary 16550 port.
```

## src/drivers/display/Kconfig
```kconfig
config DISPLAY
    bool "Display Driver"
    help 
        Enable Kernel Framebuffer support.

if DISPLAY
menu "Display Drivers"

config DISPLAY_VGA
    bool "VGA Framebuffer"
    depends on X86_BASE
    help
        Driver that utilize the VGA Framebuffer.

endmenu

endif # if DISPLAY
```

## src/drivers/framebuffer/Kconfig
```kconfig
if FRAMEBUFFER
menu "Framebuffer Drivers"

config FRAMEBUFFER_VGA
    bool "VGA Framebuffer"
    depends on X86_BASE
    help
        Driver that utilize the VGA Framebuffer.

endmenu

endif # if Framebuffer
```

## src/drivers/irqchip/Kconfig
```kconfig
menu "IRQ Chips"

config IRQCHIP_8259
    bool "Intel 8259"
    depends on X86_BASE
    help
        The standard IRQ Chip found in all IBM-PC compatibles.

endmenu
```

## src/libc/Kconfig
```kconfig
menuconfig LIBC
    bool "Standard Library Functions"
    select LIBC_MATH
    select LIBC_STDIO
    select LIBC_STRING
    help 
        Standard library functionality is used throughout the kernel. Do not
        disable this functionality unless you know what you are doing.
if LIBC

config LIBC_MATH
    bool "<math.h> Compatiblity"
    help
        Enables functions found in math.h

config LIBC_STDIO
    bool "<stdio.h> Compatibility"
    help
        Enables functions found in stdio.h

config LIBC_STRING
    bool "<string.h> Compatibility"
    default y
    help
        Enables functions found in string.h

endif
```

## src/subsys/Kconfig
```kconfig
menu Subsystems

config TIMEKEEPING
    bool "Timekeeping"
    default y
    help
        This option enables the kernel to have support for timekeeping functions

config CONSOLE
    bool "Kernel Console"
    default y
    help
        This option allows the kernel to log it's status to external devices.

config FRAMEBUFFER
    bool "Framebuffer"
    help
        This enables kernel framebuffer support.

config IRQ
    bool "Hardware IRQ"
    help
        This enables kernel support of the IRQ Subsystem

config BASE_SYSTEM
    bool "System Management"
    help
        This enables kernel support for base system devices

endmenu
```

## src/test/Kconfig
```kconfig
config TESTING
    bool "Enable Kernel Unit Tests"
    help
        This option enables the unit testing of the base kernel.
        When this is active, testing support will be compiled in.
        Please note that the kernel will not function normally if
        this is selected.
```
